## conf/layer.conf
```bitbake
# It really depends on order of the layers appearing in BBLAYERS
# variable in toplevel bblayers.conf file, where bitbake will search
# for .inc files and others where bitbake uses BBPATH since it will
# search the directories from first to last as specified in BBPATH
# Therefore if you want a given layer to be considered high priority
# for the .inc and .conf etc. then consider it adding at the beginning
# of BBPATH. For bblayers bitbake will use BBFILES_PRIORITY to resolve
# the recipe contention so the order of directories in BBFILES does
# not matter.

# bblayers.conf should look like this:
# BBLAYERS ?= " \
#   /home/chris/yocto/poky/meta \
#   /home/chris/yocto/poky/meta-poky \
#   /home/chris/yocto/poky/meta-yocto-bsp \
#   /home/chris/yocto/meta-raspberrypi \
#   /home/chris/yocto/meta-k3remote \
#   /home/chris/yocto/meta-openembedded/meta-oe \
#   /home/chris/yocto/meta-openembedded/meta-python \
#   /home/chris/yocto/meta-openembedded/meta-networking \
#   /home/chris/yocto/meta-openembedded/meta-multimedia \
#   /home/chris/yocto/meta-qt5 \
# "

# Required for samba - don't want this in local.conf or it gets lost
DISTRO_FEATURES:append = " pam"
hostname:pn-base-files = "pi-k3remote"

# We have a conf and classes directory, append to BBPATH
BBPATH .= ":${LAYERDIR}"

# We have a recipes directory, add to BBFILES
BBFILES += "${LAYERDIR}/recipes-*/*/*.bb ${LAYERDIR}/recipes-*/*/*.bbappend"

BBFILE_COLLECTIONS += "k3remote"
BBFILE_PATTERN_k3remote := "^${LAYERDIR}/"

# Define the priority for recipes (.bb files) from this layer,
# choosing carefully how this layer interacts with all of the
# other layers.

BBFILE_PRIORITY_k3remote = "7"

# This should only be incremented on significant changes that will
# cause compatibility issues with other layers
LAYERVERSION_k3remote = "1"

LAYERDEPENDS_k3remote = "core"
LAYERDEPENDS_k3remote:append = " meta-python"
# LAYERDEPENDS_k3remote:append = " meta-qt5"
# LAYERDEPENDS_k3remote += "meta-oe"

# LAYERDEPENDS_k3remote += "meta-networking"
# LAYERDEPENDS_k3remote += "meta-raspberrypi"
# LAYERDEPENDS_k3remote += "meta-gstreamer1.0"

LAYERSERIES_COMPAT_k3remote = "kirkstone"
```
